## config/boards/shields/pad_pocket/Kconfig.defconfig
```kconfig
if SHIELD_PADPOCKETTRIO

config ZMK_KEYBOARD_NAME
    default "Pad Pocket Trio"

endif
```

## config/boards/shields/pad_pocket/Kconfig.shield
```kconfig
config SHIELD_PADPOCKETTRIO
    def_bool $(shields_list_contains,pad_pocket_trio)
```
